## arch/arm/mach-msm/cust/Kconfig
```kconfig
if CUST_PANTECH_H

#
# PANTECH Cust feature section
#

config PANTECH_DOMESTIC
  bool

config PANTECH_DEBUG_ON
    bool
    default n
    select PANTECH_DEBUG
    help
        this config is dummy. you do not use this config.
        this config is used to just delete few configure when build environment is user-build-mode.

config PANTECH_DEBUG
    bool "PANTECH Debug Configuration"
    default n
    select PANTECH_DEBUG_SCHED_LOG
    select PANTECH_DEBUG_IRQ_LOG
    select PANTECH_DEBUG_DCVS_LOG
    select PANTECH_DEBUG_RPM_LOG

config PANTECH_DEBUG_SCHED_LOG
	bool
	depends on PANTECH_DEBUG
	default n

config PANTECH_DEBUG_IRQ_LOG
	bool
	depends on PANTECH_DEBUG
	default n	

config PANTECH_DEBUG_DCVS_LOG
	bool
	depends on PANTECH_DEBUG
	default n	

config PANTECH_DEBUG_RPM_LOG
	bool
	depends on PANTECH_DEBUG
	default n
	
comment "PANTECH USB Driver"
config ANDROID_PANTECH_USB
  bool "PANTECH USB"
  default y
  select PANTECH_DOMESTIC
	 help
     Support Pantech USB

config USB_ANDROID_ACCESSORY
  depends on ANDROID_PANTECH_USB && PANTECH_DOMESTIC
  bool "PANTECH USB Accessory"
  default y
	 help
     Support Pantech USB Accessory

config ANDROID_PANTECH_USB_MANAGER
  depends on ANDROID_PANTECH_USB
  bool "PANTECH USB Manager"
  default y
  help
     Support Pantech USB Manager

config ANDROID_PANTECH_USB_CDFREE
  depends on ANDROID_PANTECH_USB && PANTECH_VERIZON
  bool "PANTECH USB Cdfree"
  default y
	 help
     Support Pantech USB Cdfree 

config ANDROID_PANTECH_USB_USBNET
  depends on ANDROID_PANTECH_USB && PANTECH_VERIZON
    bool "PANTECH USBNET FUNCTION"
    default y
    help 
      Support Pantech USBNET function Driver
	  	  
config ANDROID_PANTECH_USB_OBEX
  depends on ANDROID_PANTECH_USB && PANTECH_DOMESTIC
    bool "PANTECH OBEX FUNCTION"
    default y
    help 
      Support Pantech Obex function Driver

config ANDROID_PANTECH_USB_ACCESSORY_QC_PATCH
  depends on USB_ANDROID_ACCESSORY
    bool "PANTECH ACCESSORY FUNCTION QC PATCH"
    default y
    help 
      Support Pantech ACCESSORY function Driver QC Patch

config ANDROID_PANTECH_USB_FACTORY_CABLE
  depends on ANDROID_PANTECH_USB
  bool "PANTECH USB FACTORY CABLE"
  default y
	 help
     Support Pantech USB

# jylee 121022 
config ANDROID_PANTECH_USB_ABNORMAL_CHARGER_INFO
  depends on ANDROID_PANTECH_USB
  bool "PANTECH ABNORMAL CHARGER"
  default y
     help
	 Support ABNORMAL CHARGER
endif
```
